## platform/ext/target/stm/common/devicetree/bindings/ddr/st,stm32mp2-ddr.yaml
```yaml
# Copyright (c) 2023 STMICROELECTRONICS
# SPDX-License-Identifier: Apache-2.0

description: |
  STM32 ddr controller provides a complete memory interface solution for the DDR memory
  subsystem (DDRCTRL and DDRPHY).
  Jedec compliant lpddr4, ddr4, ddr3l

compatible: "st,stm32mp2-ddr"

include: [base.yaml]

properties:
  reg:
    required: true

  reg-names:
    required: true
    description: Name of each register space "ctrl", "phy", "dbg"

  clocks:
    required: true

  st,mem-name:
    type: string
    required: true
    description: name for the DDR configuration, a simple string for information

  st,mem-name-512MBx32:
    type: string
    required: true
    description: name for the DDR configuration, a simple string for information

  st,mem-name-1GBx32:
    type: string
    required: true
    description: name for the DDR configuration, a simple string for information

  st,mem-name-4GBx32:
    type: string
    required: true
    description: name for the DDR configuration, a simple string for information

  st,mem-name-512MBx16:
    type: string
    required: true
    description: name for the DDR configuration, a simple string for information

  st,mem-name-1GBx16:
    type: string
    required: true
    description: name for the DDR configuration, a simple string for information

  st,mem-name-2GBx16:
    type: string
    required: true
    description: name for the DDR configuration, a simple string for information

  st,mem-speed:
    type: int
    required: true
    description: DDR expected speed in kHz

  st,mem-size:
    type: int
    required: true
    description: DDR mem size in bytes

  st,mem-size-512MB:
    type: int
    required: true
    description: DDR mem size in bytes

  st,mem-size-1GB:
    type: int
    required: true
    description: DDR mem size in bytes

  st,mem-size-4GB:
    type: int
    required: true
    description: DDR mem size in bytes

  st,ctl-reg:
    type: array
    required: true
    description: controller values depending on the DDR type

  st,ddr-mstr-16bits:
    type: int
    required: true
    description: mstr value depending on the DDR type

  st,ctl-timing:
    type: array
    required: true
    description: controller values depending on the DDR frequency and timing parameters

  st,ddr-rfshtmg-512MB:
    type: int
    required: true
    description: controller values depending on the DDR frequency and timing parameters

  st,ddr-rfshtmg-1GB:
    type: int
    required: true
    description: controller values depending on the DDR frequency and timing parameters

  st,ddr-rfshtmg-4GB:
    type: int
    required: true
    description: controller values depending on the DDR frequency and timing parameters

  st,ddr-dramtmg14-512MB:
    type: int
    required: true
    description: controller values depending on the DDR frequency and timing parameters

  st,ddr-dramtmg14-1GB:
    type: int
    required: true
    description: controller values depending on the DDR frequency and timing parameters

  st,ddr-dramtmg14-4GB:
    type: int
    required: true
    description: controller values depending on the DDR frequency and timing parameters

  st,ctl-map:
    type: array
    required: true
    description: controller values depending on the address mapping

  st,ctl-map-512MBx32:
    type: array
    required: true
    description: controller values depending on the address mapping

  st,ctl-map-512MBx16:
    type: array
    required: true
    description: controller values depending on the address mapping

  st,ctl-map-1GBx32:
    type: array
    required: true
    description: controller values depending on the address mapping

  st,ctl-map-1GBx16:
    type: array
    required: true
    description: controller values depending on the address mapping

  st,ctl-map-2GBx16:
    type: array
    required: true
    description: controller values depending on the address mapping

  st,ctl-map-4GBx32:
    type: array
    required: true
    description: controller values depending on the address mapping

  st,ctl-perf:
    type: array
    required: true
    description: controller values depending on performance and scheduling

  st,phy-basic:
    type: array
    required: true
    description: basic entry values for the PHYINIT driver

  st,ddr-uib-numactivedbytedfi1-16:
    type: int
    required: true
    description: basic entry value for the PHYINIT driver

  st,phy-advanced:
    type: array
    required: true
    description: advanced entry values for the PHYINIT driver

  st,phy-mr:
    type: array
    required: true
    description: mode register entry values for the PHYINIT driver

  st,phy-swizzle:
    type: array
    required: true
    description: swizzling (i.e. signal/ball multiplexing) entry values for the PHYINIT driver

  vpp-supply:
    type: phandle
    description: Reference to the regulator that controls vpp power

  vdd-supply:
    type: phandle
    description: Reference to the regulator that controls vdd power

  vref-supply:
    type: phandle
    description: Reference to the regulator that controls vref power

  vtt-supply:
    type: phandle
    description: Reference to the regulator that controls vtt power

  vdd1-supply:
    type: phandle
    description: Reference to the regulator that controls vdd1 power

  vdd2-supply:
    type: phandle
    description: Reference to the regulator that controls vdd2 power

  vddq-supply:
    type: phandle
    description: Reference to the regulator that controls vddq power
```
