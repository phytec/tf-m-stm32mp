// SPDX-License-Identifier: (GPL-2.0+ OR BSD-3-Clause)
/*
 * Copyright (C) 2025 PHYTEC Messtechnik GmbH
 * Authors: Christophe Parant <c.parant@phytec.fr>
 *          Nicolas Raimundo <n.raimundo@phytec.fr>
 */

&ddr{
	st,mem-name-512MBx32 = DDR_MEM_NAME_512MBx32;
	st,mem-size-512MB = <(DDR_MEM_SIZE_512MB & 0xFFFFFFFF)>;

	st,mem-name-1GBx32 = DDR_MEM_NAME_1GBx32;
	st,mem-size-1GB = <(DDR_MEM_SIZE_1GB & 0xFFFFFFFF)>;

	st,mem-name-4GBx32 = DDR_MEM_NAME_4GBx32;
	st,mem-size-4GB = <(DDR_MEM_SIZE & 0xFFFFFFFF)>;

	st,mem-name-512MBx16 = DDR_MEM_NAME_512MBx16;

	st,mem-name-1GBx16 = DDR_MEM_NAME_1GBx16;

	st,mem-name-2GBx16 = DDR_MEM_NAME_2GBx16;

	st,ddr-mstr-16bits = <DDR_MSTR_16>;

	st,ddr-rfshtmg-512MBx32 = <DDR_RFSHTMG_512MBx32>;
	st,ddr-rfshtmg-512MBx16 = <DDR_RFSHTMG_512MBx16>;
	st,ddr-rfshtmg-1GBx32 = <DDR_RFSHTMG_1GBx32>;
	st,ddr-rfshtmg-1GBx16 = <DDR_RFSHTMG_1GBx16>;
	st,ddr-rfshtmg-2GBx16 = <DDR_RFSHTMG_2GBx16>;
	st,ddr-rfshtmg-4GBx32 = <DDR_RFSHTMG_4GBx32>;

	st,ddr-dramtmg14-512MBx32 = <DDR_DRAMTMG14_512MBx32>;
	st,ddr-dramtmg14-1GBx32 = <DDR_DRAMTMG14_1GBx32>;
	st,ddr-dramtmg14-4GBx32 = <DDR_DRAMTMG14_4GBx32>;
	st,ddr-dramtmg14-512MBx16 = <DDR_DRAMTMG14_512MBx16>;
	st,ddr-dramtmg14-1GBx16 = <DDR_DRAMTMG14_1GBx16>;
	st,ddr-dramtmg14-2GBx16 = <DDR_DRAMTMG14_2GBx16>;

	st,ddr-uib-numactivedbytedfi1-16 = <DDR_UIB_NUMACTIVEDBYTEDFI1_16>;

	st,ctl-map-512MBx32 = <
		DDR_ADDRMAP0_512MBx32
		DDR_ADDRMAP1_512MBx32
		DDR_ADDRMAP2_512MBx32
		DDR_ADDRMAP3_512MBx32
		DDR_ADDRMAP4_512MBx32
		DDR_ADDRMAP5_512MBx32
		DDR_ADDRMAP6_512MBx32
		DDR_ADDRMAP7_512MBx32
		DDR_ADDRMAP8_512MBx32
		DDR_ADDRMAP9_512MBx32
		DDR_ADDRMAP10_512MBx32
		DDR_ADDRMAP11_512MBx32
	>;

	st,ctl-map-512MBx16 = <
		DDR_ADDRMAP0_512MBx16
		DDR_ADDRMAP1_512MBx16
		DDR_ADDRMAP2_512MBx16
		DDR_ADDRMAP3_512MBx16
		DDR_ADDRMAP4_512MBx16
		DDR_ADDRMAP5_512MBx16
		DDR_ADDRMAP6_512MBx16
		DDR_ADDRMAP7_512MBx16
		DDR_ADDRMAP8_512MBx16
		DDR_ADDRMAP9_512MBx16
		DDR_ADDRMAP10_512MBx16
		DDR_ADDRMAP11_512MBx16
	>;

	st,ctl-map-1GBx32 = <
		DDR_ADDRMAP0_1GBx32
		DDR_ADDRMAP1_1GBx32
		DDR_ADDRMAP2_1GBx32
		DDR_ADDRMAP3_1GBx32
		DDR_ADDRMAP4_1GBx32
		DDR_ADDRMAP5_1GBx32
		DDR_ADDRMAP6_1GBx32
		DDR_ADDRMAP7_1GBx32
		DDR_ADDRMAP8_1GBx32
		DDR_ADDRMAP9_1GBx32
		DDR_ADDRMAP10_1GBx32
		DDR_ADDRMAP11_1GBx32
	>;

	st,ctl-map-1GBx16 = <
		DDR_ADDRMAP0_1GBx16
		DDR_ADDRMAP1_1GBx16
		DDR_ADDRMAP2_1GBx16
		DDR_ADDRMAP3_1GBx16
		DDR_ADDRMAP4_1GBx16
		DDR_ADDRMAP5_1GBx16
		DDR_ADDRMAP6_1GBx16
		DDR_ADDRMAP7_1GBx16
		DDR_ADDRMAP8_1GBx16
		DDR_ADDRMAP9_1GBx16
		DDR_ADDRMAP10_1GBx16
		DDR_ADDRMAP11_1GBx16
	>;

	st,ctl-map-2GBx16 = <
		DDR_ADDRMAP0_2GBx16
		DDR_ADDRMAP1_2GBx16
		DDR_ADDRMAP2_2GBx16
		DDR_ADDRMAP3_2GBx16
		DDR_ADDRMAP4_2GBx16
		DDR_ADDRMAP5_2GBx16
		DDR_ADDRMAP6_2GBx16
		DDR_ADDRMAP7_2GBx16
		DDR_ADDRMAP8_2GBx16
		DDR_ADDRMAP9_2GBx16
		DDR_ADDRMAP10_2GBx16
		DDR_ADDRMAP11_2GBx16
	>;

	st,ctl-map-4GBx32= <
		DDR_ADDRMAP0_4GBx32
		DDR_ADDRMAP1_4GBx32
		DDR_ADDRMAP2_4GBx32
		DDR_ADDRMAP3_4GBx32
		DDR_ADDRMAP4_4GBx32
		DDR_ADDRMAP5_4GBx32
		DDR_ADDRMAP6_4GBx32
		DDR_ADDRMAP7_4GBx32
		DDR_ADDRMAP8_4GBx32
		DDR_ADDRMAP9_4GBx32
		DDR_ADDRMAP10_4GBx32
		DDR_ADDRMAP11_4GBx32
	>;

};
